## prj.conf
```kconfig
# APPLICATION CONFIGURATION
#CONFIG_MIDGE_IMU_ICM20948_USE_CLOSED_DRIVER=n


# General
CONFIG_STD_C17=y
CONFIG_GNU_C_EXTENSIONS=y
CONFIG_CRC=y
CONFIG_REBOOT=y

CONFIG_PRINTK=y
CONFIG_LOG=y
CONFIG_MAIN_STACK_SIZE=2048
CONFIG_OUTPUT_DISASSEMBLY=y
#CONFIG_MISRA_SANE=y
#CONFIG_CODING_GUIDELINE_CHECK=y
CONFIG_COMPILER_WARNINGS_AS_ERRORS=y

# Bluetooth
CONFIG_BT=y
CONFIG_BT_PERIPHERAL=y
CONFIG_BT_ZEPHYR_NUS=y
CONFIG_BT_OBSERVER=y
CONFIG_BT_DEVICE_NAME="MingleMidge"
CONFIG_BT_MAX_CONN=1
CONFIG_BT_RX_STACK_SIZE=4096
## FASTER DOWNLOAD SPEED
CONFIG_BT_BUF_ACL_TX_COUNT=9
CONFIG_BT_BUF_EVT_RX_COUNT=10

# IMU
CONFIG_I2C=y
CONFIG_GPIO_ENABLE_DISABLE_INTERRUPT=y
CONFIG_SENSOR=y

# IMU TESTING
CONFIG_SHELL=y
CONFIG_SHELL_BACKEND_RTT=y
CONFIG_SHELL_PROMPT_RTT="RTT:0> "

# Audio
CONFIG_AUDIO=y
CONFIG_AUDIO_DMIC=y

# Battery charge
CONFIG_GPIO=y
CONFIG_ADC=y

# SDMMC
CONFIG_DISK_ACCESS=y
CONFIG_FILE_SYSTEM=y
CONFIG_FAT_FILESYSTEM_ELM=y
# need to add to doc
CONFIG_FS_FATFS_REENTRANT=y
CONFIG_FILE_SYSTEM_MKFS=y
# FILE_TYPE_MAX in storage.h + 1 for timesync file
CONFIG_FS_FATFS_NUM_FILES=8

# Mover a un overlay de conf (?)
CONFIG_DISK_DRIVER_SDMMC=y
CONFIG_SPI=y
CONFIG_BOOTLOADER_MCUBOOT=n

# PWM
CONFIG_LED=y

#CONFIG_TIMESLICE_SIZE=5
CONFIG_TIMESLICING=y
CONFIG_MAIN_THREAD_PRIORITY=0
#CONFIG_SCHED_SIMPLE=y

# callbacks command
CONFIG_SYSTEM_WORKQUEUE_STACK_SIZE=2048
CONFIG_CBPRINTF_FP_SUPPORT=y
```

## src/main.c
```c
#include <zephyr/device.h>
#include <zephyr/kernel.h>
#include <zephyr/logging/log.h>
#include <zephyr/sys/util.h>

#include "audio.h"
#include "battery_charge.h"
#include "cmd_processor.h"
#include "imu.h"
#include "midge_protocol.h"
#include "privacy_switch.h"
#include "proximity.h"
#include "status_led.h"
#include "storage.h"
#include "time_control.h"
#include "imu_interface.h"

LOG_MODULE_REGISTER(main_module);
struct init_item {
    int (*fn)(void);
    const char* name;
};

static int run_inits(const struct init_item* items, size_t n) {
    int ret = 0;
    for (size_t i = 0; i < n; i++) {
        ret = items[i].fn();
        if (ret < 0) {
            LOG_ERR("Failed to initialize %s", items[i].name);
            break;
        }
    }
    led_report_status(ret);
    return ret;
}

int main() {
    int ret = led_init(); 
    if (ret < 0) {
        LOG_ERR("Failed to initialize LED");
        return ret;
    }

    const struct init_item inits[] = {
        {storage_init_fs, "storage"},
        {battery_charge_init, "battery charge sensor"},
        {audio_sensor_init, "audio sensor"},
        {switch_sensor_init, "switch sensor"},
        {proximity_sensor_init, "proximity sensor"},
        {imu_sensor_init, "IMU sensor"},
        {cmd_processor_init, "command processor"},
    };

    ret = run_inits(inits, ARRAY_SIZE(inits));


    // ################ TEST CODE FOR IMU_CALIBRATION ################


    // ################ END OF THE TEST IMU_CALIBRATION CODE :) ################


    /*audio_sensor_start(2, 1);
    k_sleep(K_SECONDS(60*3));
    audio_sensor_stop();*/
    led_report_active(false);
    return ret;
}

/** HACKS and WORKAROUNDS */

#ifdef CONFIG_BOARD_MIDGE_BADGE_V2

union pin_cfg {
    struct {
        uint32_t dir : 1;
        uint32_t input : 1;
        uint32_t pull : 2;
        uint32_t _reserved1 : 4;
        uint32_t drive : 3;
        uint32_t _reserved2 : 5;
        uint32_t sense : 2;
    };
    uint32_t raw;
};

static int lsm6dso_int_pin_hack(void) {
    // force the int pin as a output 0 during init so the imu can enter i2c mode
    // an be recognized during driver init

    // This code manually controls the GPIO block described in
    // https://docs.nordicsemi.com/r/bundle/ps_nrf52840/page/gpio.html
    uint32_t addr = 0x50000000;
    //*(volatile uint32_t *)(addr | 0x518) = (1<<30);
    //*(volatile uint32_t *)(addr | 0x508) = (1<<30);
    union pin_cfg cfg = {
        .dir = 1,  // output
        .input = 0,
        .pull = 1,
    };
    *(volatile uint32_t*)(addr | 0x778) = cfg.raw;

    return 0;
}

// Hook into PRE_KERNEL_1 with priority 50
SYS_INIT(lsm6dso_int_pin_hack, PRE_KERNEL_1, 50);

#endif
```

## src/imu.c
```c
#include "imu.h"

#include <errno.h>
#include <zephyr/kernel.h>
#include <zephyr/logging/log.h>
#include <zephyr/sys/util.h>
#include <math.h>

#include "imu_interface.h"
#include "midge_protocol.h"
#include "storage.h"
#include "utility.h"


// INCLUDE SECCION FOR TEST
#include <zephyr/shell/shell.h>
#include <string.h>


LOG_MODULE_REGISTER(imu);

static uint8_t imu_sensor_state = SENSOR_STATE_DISABLED;

uint8_t imu_sensor_get_status() { return imu_sensor_state; }

int imu_sensor_init() {
    int ret = imu_drv_api.init();
    if (ret != 0) {
        imu_sensor_state = SENSOR_STATE_ERR;
        LOG_ERR("Failed to initialize IMU driver: %d", ret);
    } else {
        imu_sensor_state = SENSOR_STATE_STOP;
        LOG_INF("IMU driver initialized successfully");
    }
    return ret;
}

int imu_sensor_start(int sample_iter, uint16_t acc_fsr, uint16_t gyr_fsr, uint16_t datarate) {
    struct imu_config config = {
        .acc_fsr = acc_fsr,
        .gyr_fsr = gyr_fsr,
        .datarate = datarate,
    };
    // set config
    int ret = imu_drv_api.set_config(&config);
    if (ret != 0) {
        LOG_ERR("Failed to set IMU config: %d", ret);
        return ret;
    }

    // start sampling
    ret = imu_drv_api.start(sample_iter);
    if (ret != 0) {
        LOG_ERR("Failed to start IMU sampling: %d", ret);
        imu_sensor_state = SENSOR_STATE_ERR;
    } else {
        LOG_INF("IMU sampling started successfully");
        imu_sensor_state = SENSOR_STATE_ACTIVE;
    }
    return ret;
}

int imu_sensor_stop() {
    int ret = imu_drv_api.stop();
    if (ret != 0) {
        LOG_ERR("Failed to stop IMU sampling: %d", ret);
        imu_sensor_state = SENSOR_STATE_ERR;
    } else {
        LOG_INF("IMU sampling stopped successfully");
        imu_sensor_state = SENSOR_STATE_STOP;
    }
    return ret;
}

struct start_imu_work_ctx {
    struct k_work work;
    struct k_sem done;
    uint16_t sample_id;
    uint16_t acc_fsr;
    uint16_t gyr_fsr;
    uint16_t datarate;
    int ret;
};

static void start_imu_work_handler(struct k_work* work) {
    struct start_imu_work_ctx* ctx = CONTAINER_OF(work, struct start_imu_work_ctx, work);
    ctx->ret = imu_sensor_start(ctx->sample_id, ctx->acc_fsr, ctx->gyr_fsr, ctx->datarate);
    k_sem_give(&ctx->done);
}

int cmd_start_imu(uint8_t* data) {
    struct cmd_start_imu_request* req_data = (struct cmd_start_imu_request*)data;
    struct start_imu_work_ctx ctx = {.sample_id = req_data->sample_id,
                                     .acc_fsr = req_data->acc_fsr,
                                     .gyr_fsr = req_data->gyr_fsr,
                                     .datarate = req_data->datarate};
    k_sem_init(&ctx.done, 0, 1);
    k_work_init(&ctx.work, start_imu_work_handler);
    int ret = k_work_submit(&ctx.work);
    if (ret < 0) {
        LOG_ERR("Failed to submit start imu work: %d", ret);
    } else {
        ret = k_sem_take(&ctx.done, K_FOREVER);
        if (ret != 0) {
            LOG_ERR("Failed to take semaphore for start imu work: %d", ret);
        } else {
            ret = ctx.ret;
        }
    }

    struct cmd_start_imu_response* resp_data = (struct cmd_start_imu_response*)data;
    memset(resp_data, 0, sizeof(struct cmd_start_imu_response));
    resp_data->status_code = ret;
    return ret;
}

static void stop_imu_work_handler(struct k_work* work) {
    struct simple_work_ctx* ctx = CONTAINER_OF(work, struct simple_work_ctx, work);
    ctx->ret = imu_sensor_stop();
    k_sem_give(&ctx->done);
}

int cmd_stop_imu(uint8_t* data) {
    // struct cmd_stop_imu_request* req_data = (struct cmd_stop_imu_request*)data;
    struct cmd_stop_imu_response* resp_data = (struct cmd_stop_imu_response*)data;
    struct simple_work_ctx ctx;
    k_work_init(&ctx.work, stop_imu_work_handler);
    k_sem_init(&ctx.done, 0, 1);

    int ret;
    int submit_ret = k_work_submit(&ctx.work);
    if (submit_ret < 0) {
        ret = submit_ret;
    } else {
        k_sem_take(&ctx.done, K_FOREVER);
        ret = ctx.ret;
    }
    resp_data->status_code = ret;
    return ret;
}

/**
 * @brief Checks whether two IMU samples meet the stationary criteria.
 *
 * Checks that the accelerometer and gyroscope readings do not vary
 * more than their configured tolerances. It also checks that each
 * gyroscope axis remains close to zero.
 *
 * When the same sample is passed as both arguments, the function
 * checks only whether the gyroscope readings are close to zero.
 *
 * @param previous Pointer to the previous IMU sample.
 * @param current Pointer to the current IMU sample.
 *
 * @return 0 if the readings meet the criteria,
 *         -EINVAL if either pointer is NULL,
 *         or -EAGAIN if a tolerance is exceeded.
 */
static int imu_calibration_calculate_error(
    const struct imu_sample *previous,
    const struct imu_sample *current)
{
    if (previous == NULL || current == NULL) {
        return -EINVAL;
    }

    for (int axis = 0; axis < 3; axis++) {
        // Check that the gyroscope reading is close to zero.
        if (fabsf(current->gyro[axis]) >
            IMU_CALIBRATION_GYRO_ERROR) {
            return -EAGAIN;
        }

        // Check the variation between consecutive accelerometer samples.
        float accel_diff =
            current->accel[axis] - previous->accel[axis];

        if (fabsf(accel_diff) > IMU_CALIBRATION_ACCEL_ERROR) {
            return -EAGAIN;
        }

        // Check the variation between consecutive gyroscope samples.
        float gyro_diff =
            current->gyro[axis] - previous->gyro[axis];

        if (fabsf(gyro_diff) > IMU_CALIBRATION_GYRO_ERROR) {
            return -EAGAIN;
        }
    }

    return 0;
}

/**
 * @brief Checks whether the device remains stationary during sampling.
 *
 * Reads IMU_CALIBRATION_SAMPLE_COUNT samples and checks each sample
 * against the previous one using imu_calibration_calculate_error().
 *
 * @return 0 if all samples meet the stationary criteria,
 *         -EAGAIN if movement or excessive variation is detected,
 *         or another negative error code if a sensor read fails.
 */
int imu_calibration_check_stationary(void)
{
    struct imu_sample previous_sample;

    // Read the first sample.
    int ret = imu_drv_api.read_sample(&previous_sample);
    if (ret != 0) {
        LOG_ERR("Failed to read initial stationary check sample: %d", ret);
        return ret;
    }

    // Check the initial gyroscope readings.
    ret = imu_calibration_calculate_error(
        &previous_sample, &previous_sample);

    if (ret != 0) {
        return ret;
    }

    // Read and validate the remaining samples.
    for (int i = 1; i < IMU_CALIBRATION_SAMPLE_COUNT; i++) {
        struct imu_sample current_sample;

        ret = imu_drv_api.read_sample(&current_sample);
        if (ret != 0) {
            LOG_ERR("Failed to read stationary check sample %d: %d",
                    i, ret);
            return ret;
        }

        ret = imu_calibration_calculate_error(
            &previous_sample, &current_sample);

        if (ret != 0) {
            return ret;
        }

        // Keep the current sample for the next comparison.
        previous_sample = current_sample;
    }

    return 0;
}

/**
 * @brief Collects IMU samples, verifies stability, and calculates averages.
 *
 * Each sample is checked before its readings are added to the sums.
 * The averages are stored only if all samples meet the stationary criteria.
 *
 * @param measurement Pointer to the structure where the averages
 *                    will be stored.
 *
 * @return 0 on success,
 *         -EINVAL if measurement is NULL,
 *         -EAGAIN if movement or excessive variation is detected,
 *         or another negative error code if a sensor read fails.
 */
int imu_calibration_collect_average(
    struct imu_calibration_measurement *measurement)
{
    if (measurement == NULL) {
        return -EINVAL;
    }

    // Initialize the sums for the accelerometer and gyroscope axes.
    float accel_sum[3] = {0.0f, 0.0f, 0.0f};
    float gyro_sum[3] = {0.0f, 0.0f, 0.0f};

    struct imu_sample previous_sample = {0};

    // Read and validate the configured number of samples.
    for (int i = 0; i < IMU_CALIBRATION_SAMPLE_COUNT; i++) {
        struct imu_sample current_sample;

        int ret = imu_drv_api.read_sample(&current_sample);
        if (ret != 0) {
            LOG_ERR("Failed to read calibration sample %d: %d", i, ret);
            return ret;
        }

        // Validate the first sample and compare subsequent samples.
        if (i == 0) {
            ret = imu_calibration_calculate_error(
                &current_sample, &current_sample);
        } else {
            ret = imu_calibration_calculate_error(
                &previous_sample, &current_sample);
        }

        if (ret != 0) {
            LOG_WRN("Movement detected during calibration at sample %d", i);
            return ret;
        }

        // Accumulate readings only after the sample passes validation.
        for (int axis = 0; axis < 3; axis++) {
            accel_sum[axis] += current_sample.accel[axis];
            gyro_sum[axis] += current_sample.gyro[axis];
        }

        // Save the current sample for the next comparison.
        previous_sample = current_sample;
    }

    // Calculate and store the average for each axis.
    for (int axis = 0; axis < 3; axis++) {
        measurement->accel[axis] =
            accel_sum[axis] / (float)IMU_CALIBRATION_SAMPLE_COUNT;

        measurement->gyro[axis] =
            gyro_sum[axis] / (float)IMU_CALIBRATION_SAMPLE_COUNT;
    }

    return 0;
}

/**
 * @brief Checks whether the measured acceleration matches an orientation.
 *
 * Collects stable IMU measurements and compares the average acceleration
 * against the expected gravity vector for the requested orientation.
 *
 * @param orientation Expected calibration orientation.
 * @param measurement Output structure for the collected averages.
 *
 * @return IMU_CALIBRATION_OK if the orientation is correct,
 *         IMU_CALIBRATION_MOVEMENT_DETECTED if movement is detected,
 *         IMU_CALIBRATION_WRONG_ORIENTATION if the pose does not match,
 *         or a negative error code if an argument or sensor operation fails.
 */
int imu_calibration_check_orientation(
    enum imu_calibration_orientation orientation,
    struct imu_calibration_measurement *measurement)
{
    if (measurement == NULL ||
        orientation < IMU_CALIBRATION_ORIENTATION_X_POS ||
        orientation >= IMU_CALIBRATION_ORIENTATION_COUNT) {
        return -EINVAL;
    }

    int ret = imu_calibration_collect_average(measurement);

    if (ret == -EAGAIN) {
        return IMU_CALIBRATION_MOVEMENT_DETECTED;
    }

    if (ret != 0) {
        return ret;
    }

    const float gravity = 9.81f;
    const float tolerance = IMU_CALIBRATION_ORIENTATION_TOLERANCE;

    float expected[3] = {0.0f, 0.0f, 0.0f};

    switch (orientation) {
    case IMU_CALIBRATION_ORIENTATION_X_POS:
        expected[0] = gravity;
        break;

    case IMU_CALIBRATION_ORIENTATION_X_NEG:
        expected[0] = -gravity;
        break;

    case IMU_CALIBRATION_ORIENTATION_Y_POS:
        expected[1] = gravity;
        break;

    case IMU_CALIBRATION_ORIENTATION_Y_NEG:
        expected[1] = -gravity;
        break;

    case IMU_CALIBRATION_ORIENTATION_Z_POS:
        expected[2] = gravity;
        break;

    case IMU_CALIBRATION_ORIENTATION_Z_NEG:
        expected[2] = -gravity;
        break;

    default:
        return -EINVAL;
    }

    for (int axis = 0; axis < 3; axis++) {
        if (fabsf(measurement->accel[axis] - expected[axis]) > tolerance) {
            return IMU_CALIBRATION_WRONG_ORIENTATION;
        }
    }

    return IMU_CALIBRATION_OK;
}

/**
 * @brief Stores a calibration measurement for a specific orientation.
 *
 * @param calibration_data Calibration data structure.
 * @param orientation Orientation associated with the measurement.
 * @param measurement Measurement to store.
 *
 * @return 0 on success, or -EINVAL if an argument is invalid.
 */
int imu_calibration_store_measurement(
    struct imu_calibration_data *calibration_data,
    enum imu_calibration_orientation orientation,
    const struct imu_calibration_measurement *measurement)
{
    if (calibration_data == NULL || measurement == NULL ||
        orientation < IMU_CALIBRATION_ORIENTATION_X_POS ||
        orientation >= IMU_CALIBRATION_ORIENTATION_COUNT) {
        return -EINVAL;
    }

    calibration_data->measurements[orientation] = *measurement;
    calibration_data->completed[orientation] = true;

    return 0;
}

/**
 * @brief Gets the orientations that have not been calibrated yet.
 *
 * @param calibration_data Calibration data to inspect.
 * @param missing_orientations Output array for missing orientations.
 * @param max_orientations Maximum number of entries in the output array.
 *
 * @return Number of missing orientations, or a negative error code.
 */
int imu_calibration_get_missing_orientations(
    const struct imu_calibration_data *calibration_data,
    enum imu_calibration_orientation *missing_orientations,
    size_t max_orientations)
{
    if (calibration_data == NULL ||
        (missing_orientations == NULL && max_orientations > 0)) {
        return -EINVAL;
    }

    int missing_count = 0;

    for (int i = 0; i < IMU_CALIBRATION_ORIENTATION_COUNT; i++) {
        if (!calibration_data->completed[i]) {
            if ((size_t)missing_count < max_orientations) {
                missing_orientations[missing_count] =
                    (enum imu_calibration_orientation)i;
            }

            missing_count++;
        }
    }

    if ((size_t)missing_count > max_orientations) {
        return -ENOMEM;
    }

    return missing_count;
}


// ################ DEBUG COMMANDS ################

/*
 * Calibration data retained while the firmware is running.
 */
static struct imu_calibration_data imu_debug_calibration_data;

/**
 * @brief Converts a console argument into an orientation enum.
 */
static int imu_debug_parse_orientation(
    const char *name,
    enum imu_calibration_orientation *orientation)
{
    if (name == NULL || orientation == NULL) {
        return -EINVAL;
    }

    if (strcmp(name, "+X") == 0) {
        *orientation = IMU_CALIBRATION_ORIENTATION_X_POS;
    } else if (strcmp(name, "-X") == 0) {
        *orientation = IMU_CALIBRATION_ORIENTATION_X_NEG;
    } else if (strcmp(name, "+Y") == 0) {
        *orientation = IMU_CALIBRATION_ORIENTATION_Y_POS;
    } else if (strcmp(name, "-Y") == 0) {
        *orientation = IMU_CALIBRATION_ORIENTATION_Y_NEG;
    } else if (strcmp(name, "+Z") == 0) {
        *orientation = IMU_CALIBRATION_ORIENTATION_Z_POS;
    } else if (strcmp(name, "-Z") == 0) {
        *orientation = IMU_CALIBRATION_ORIENTATION_Z_NEG;
    } else {
        return -EINVAL;
    }

    return 0;
}

/**
 * @brief Returns a readable orientation name.
 */
static const char *imu_debug_orientation_name(
    enum imu_calibration_orientation orientation)
{
    switch (orientation) {
    case IMU_CALIBRATION_ORIENTATION_X_POS:
        return "+X";
    case IMU_CALIBRATION_ORIENTATION_X_NEG:
        return "-X";
    case IMU_CALIBRATION_ORIENTATION_Y_POS:
        return "+Y";
    case IMU_CALIBRATION_ORIENTATION_Y_NEG:
        return "-Y";
    case IMU_CALIBRATION_ORIENTATION_Z_POS:
        return "+Z";
    case IMU_CALIBRATION_ORIENTATION_Z_NEG:
        return "-Z";
    default:
        return "UNKNOWN";
    }
}

/**
 * @brief Checks and stores one calibration orientation.
 *
 * Usage: imu_calibration check +X
 */
static int imu_debug_calibration_check(
    const struct shell *shell,
    size_t argc,
    char **argv)
{
    ARG_UNUSED(argc);

    enum imu_calibration_orientation orientation;

    if (imu_debug_parse_orientation(argv[1], &orientation) != 0) {
        shell_error(shell, "Invalid orientation.");
        shell_print(shell, "Use +X, -X, +Y, -Y, +Z or -Z.");
        return -EINVAL;
    }

    shell_print(shell,
                "Checking orientation %s. Keep the IMU still.",
                imu_debug_orientation_name(orientation));

    struct imu_calibration_measurement measurement;

    int ret = imu_calibration_check_orientation(
        orientation,
        &measurement
    );

    if (ret == IMU_CALIBRATION_MOVEMENT_DETECTED) {
        shell_warn(shell, "Movement detected. Please try again.");
        return 0;
    }

    if (ret == IMU_CALIBRATION_WRONG_ORIENTATION) {
        shell_warn(shell,
                   "Wrong orientation. Expected %s.",
                   imu_debug_orientation_name(orientation));
        return 0;
    }

    if (ret != IMU_CALIBRATION_OK) {
        shell_error(shell, "Orientation check failed: %d", ret);
        return ret;
    }

    ret = imu_calibration_store_measurement(
        &imu_debug_calibration_data,
        orientation,
        &measurement
    );

    if (ret != 0) {
        shell_error(shell, "Failed to store measurement: %d", ret);
        return ret;
    }

    shell_print(shell,
                "Orientation %s verified and stored.",
                imu_debug_orientation_name(orientation));

    shell_print(shell,
                "Accel [m/s^2]: X=%.3f, Y=%.3f, Z=%.3f",
                (double)measurement.accel[0],
                (double)measurement.accel[1],
                (double)measurement.accel[2]);

    shell_print(shell,
                "Gyro [rad/s]: X=%.3f, Y=%.3f, Z=%.3f",
                (double)measurement.gyro[0],
                (double)measurement.gyro[1],
                (double)measurement.gyro[2]);

    return 0;
}

/**
 * @brief Displays calibration progress.
 *
 * Usage: imu_calibration status
 */
static int imu_debug_calibration_status(
    const struct shell *shell,
    size_t argc,
    char **argv)
{
    ARG_UNUSED(argc);
    ARG_UNUSED(argv);

    enum imu_calibration_orientation missing[
        IMU_CALIBRATION_ORIENTATION_COUNT
    ];

    int count = imu_calibration_get_missing_orientations(
        &imu_debug_calibration_data,
        missing,
        ARRAY_SIZE(missing)
    );

    if (count < 0) {
        shell_error(shell,
                    "Failed to get calibration status: %d",
                    count);
        return count;
    }

    shell_print(shell,
                "Completed orientations: %d/%d",
                IMU_CALIBRATION_ORIENTATION_COUNT - count,
                IMU_CALIBRATION_ORIENTATION_COUNT);

    if (count == 0) {
        shell_print(shell, "Calibration complete.");
        return 0;
    }

    shell_print(shell, "Missing orientations:");

    for (int i = 0; i < count; i++) {
        shell_print(shell, "  %s",
                    imu_debug_orientation_name(missing[i]));
    }

    return 0;
}

SHELL_STATIC_SUBCMD_SET_CREATE(
    imu_debug_calibration_commands,
    SHELL_CMD_ARG(
        check,
        NULL,
        "Check and store an orientation: check <orientation>",
        imu_debug_calibration_check,
        2,
        0
    ),
    SHELL_CMD(
        status,
        NULL,
        "Show calibration progress",
        imu_debug_calibration_status
    ),
    SHELL_SUBCMD_SET_END
);

SHELL_CMD_REGISTER(
    imu_calibration,
    &imu_debug_calibration_commands,
    "IMU calibration debug commands",
    NULL
);

// ################ END DEBUG COMMANDS ################
```

## src/imu.h
```c
#ifndef MBFW_IMU_H
#define MBFW_IMU_H

#include <inttypes.h>
#include <stdbool.h>
#include <stddef.h>

/** Number of samples collected for each IMU calibration measurement. */
#define IMU_CALIBRATION_SAMPLE_COUNT 10

/** Maximum allowed gyroscope reading while the device is stationary (rad/s). */
#define IMU_CALIBRATION_GYRO_ERROR 0.05f

/** Maximum allowed accelerometer variation between samples (m/s^2). */
#define IMU_CALIBRATION_ACCEL_ERROR 0.15f

#define IMU_CALIBRATION_ORIENTATION_TOLERANCE 0.2f

/**
 * @brief Stores the average accelerometer and gyroscope measurements
 *        for a single orientation.
 */
struct imu_calibration_measurement {
    float accel[3]; /**< Average accelerometer readings for X, Y, and Z. */
    float gyro[3];  /**< Average gyroscope readings for X, Y, and Z. */
};

/**
 * @brief Identifies the six orientations used for IMU calibration.
 */
enum imu_calibration_orientation {
    IMU_CALIBRATION_ORIENTATION_X_POS = 0, /**< Positive X axis. */
    IMU_CALIBRATION_ORIENTATION_X_NEG = 1, /**< Negative X axis. */
    IMU_CALIBRATION_ORIENTATION_Y_POS = 2, /**< Positive Y axis. */
    IMU_CALIBRATION_ORIENTATION_Y_NEG = 3, /**< Negative Y axis. */
    IMU_CALIBRATION_ORIENTATION_Z_POS = 4, /**< Positive Z axis. */
    IMU_CALIBRATION_ORIENTATION_Z_NEG = 5, /**< Negative Z axis. */

    IMU_CALIBRATION_ORIENTATION_COUNT = 6 /**< Total number of orientations. */
};

/**
 * @brief Result of an IMU calibration orientation check.
 */
enum imu_calibration_result {
    IMU_CALIBRATION_OK = 0,
    IMU_CALIBRATION_MOVEMENT_DETECTED,
    IMU_CALIBRATION_WRONG_ORIENTATION
};

/**
 * @brief Stores calibration measurements for all six orientations.
 *
 * Each array entry corresponds to the orientation with the same index
 * in enum imu_calibration_orientation.
 */
struct imu_calibration_data {
    struct imu_calibration_measurement
        measurements[IMU_CALIBRATION_ORIENTATION_COUNT];

    bool completed[IMU_CALIBRATION_ORIENTATION_COUNT];
};

uint8_t imu_sensor_get_status();

int imu_sensor_init();

int imu_sensor_start(int sample_iter, uint16_t acc_fsr, uint16_t gyr_fsr, uint16_t datarate);

int imu_sensor_stop();

int cmd_start_imu(uint8_t* data);

int cmd_stop_imu(uint8_t* data);

int imu_calibration_check_stationary(void);


/**
 * @brief Collects IMU samples, verifies their stability, and calculates
 *        the average accelerometer and gyroscope readings.
 *
 * The average is calculated only if all collected samples meet the
 * stationary criteria.
 *
 * @param measurement Pointer to the structure where the averages
 *                    will be stored.
 *
 * @return 0 on success,
 *         -EINVAL if measurement is NULL,
 *         -EAGAIN if movement or excessive variation is detected,
 *         or another negative error code if a sensor read fails.
 */
int imu_calibration_collect_average(
    struct imu_calibration_measurement *measurement);



/**
 * @brief Checks whether the IMU is in the specified orientation.
 *
 * Collects averaged IMU measurements, checks whether the sensor is stationary,
 * and validates the accelerometer readings against the expected orientation.
 *
 * @param orientation Expected calibration orientation.
 * @param measurement Pointer to store the averaged accelerometer and gyroscope
 *                    measurements.
 *
 * @return 0 if the orientation is valid, a calibration result code if movement
 *         or an incorrect orientation is detected, or a negative error code
 *         if the operation fails.
 */
int imu_calibration_check_orientation(
    enum imu_calibration_orientation orientation,
    struct imu_calibration_measurement *measurement);

/**
 * @brief Stores a measurement for the specified calibration orientation.
 *
 * Copies the measurement into the corresponding entry in the calibration data
 * and marks the orientation as completed.
 *
 * @param calibration_data Pointer to the calibration data structure.
 * @param orientation Orientation associated with the measurement.
 * @param measurement Pointer to the measurement to store.
 *
 * @return 0 on success, or a negative error code if the arguments are invalid.
 */
int imu_calibration_store_measurement(
    struct imu_calibration_data *calibration_data,
    enum imu_calibration_orientation orientation,
    const struct imu_calibration_measurement *measurement);

/**
 * @brief Gets the orientations that have not yet been calibrated.
 *
 * Fills the output array with the missing orientations, up to the specified
 * capacity.
 *
 * @param calibration_data Pointer to the calibration data structure.
 * @param missing_orientations Array to store the missing orientations.
 * @param max_orientations Maximum number of orientations the array can hold.
 *
 * @return Number of missing orientations, or a negative error code on failure.
 */
int imu_calibration_get_missing_orientations(
    const struct imu_calibration_data *calibration_data,
    enum imu_calibration_orientation *missing_orientations,
    size_t max_orientations);



#endif  // MBFW_IMU_H
```
